// TamaTouhou firmware: Waveshare ESP32-S3-Touch-AMOLED-1.75.
// Bring-up order and the loop follow TamaPoke (MIT), with its hardware fixes built in
// (hardware notes: docs/development.md). Game rules live in lib/engine (host-tested); theme data in
// lib/theme_gen (generated by tools/build_theme.py); art on LittleFS (firmware/data/).
#include <Arduino.h>
#include <Wire.h>
#include <esp_random.h>

#include "version.h"
#include "app_platform.h"
#include "assets.h"
#include "board.h"
#include "gesture.h"
#include "gfx.h"
#include "hw_audio.h"
#include "hw_display.h"
#include "hw_power.h"
#include "hw_touch.h"
#include "nvs_kv.h"
#include "pet.h"
#include "platform_esp32.h"
#include "save_text.h"
#include "theme_data.h"
#include "ui.h"


static tama::Rng rng;
static NvsKv *kv = nullptr;
static tama::Pet *pet = nullptr;
static tama::GestureRecognizer gestures;

static uint32_t lastRender = 0, lastInteract = 0;
static uint8_t dimStage = 0;   // 0 awake, 1 dimmed (90 s), 2 nearly off (5 min)
static bool screenOff = false;

// NVS namespace per theme ("t_<hash16>"), so switching themes never touches another pet.
static const char *themeNamespace() {
  static char ns[12];
  snprintf(ns, sizeof(ns), "t_%04x", tama::hash16(tama::kTheme.id));
  return ns;
}

static void updateBrightness(uint32_t now) {
  if (ui::busyAnimating(now)) lastInteract = now;   // visible events keep the screen awake
  uint32_t idle = now - lastInteract;
  dimStage = idle > 300000 ? 2 : idle > 90000 ? 1 : 0;
  static const uint8_t kLevels[4] = {0, 70, 140, 220};   // Settings: auto, low, mid, high
  uint8_t level = platformBrightnessLevel();
  uint8_t awake = level ? kLevels[level] : (hw::usbPresent() ? 180 : 145);
  uint8_t target = pet->sleeping() ? 25 : awake;
  if (dimStage == 1) target = pet->sleeping() ? 10 : 60;
  else if (dimStage == 2) target = 8;   // AMOLED burn-in protection
  if (screenOff) target = 0;
  hw::setBrightness(target);
}

// Save export/import over the serial console, in the same TAMA-SAVE text the simulator
// writes to .tamasave files, so a pet moves between the board and a computer.
static void exportSave() {
  uint8_t *pkg = (uint8_t *)malloc(tama::Pet::kExportMax);
  size_t n = pkg ? pet->exportSave(pkg, tama::Pet::kExportMax) : 0;   // (an NVS write: ~1 s pause)
  size_t cap = tama::saveTextCapacity(n, tama::kTheme.id);
  char *text = n ? (char *)malloc(cap) : nullptr;
  if (text && tama::encodeSaveText(pkg, n, tama::kTheme.id, text, cap, true)) {
    Serial.setTxTimeoutMs(2000);   // the host is reading: let the long line through
    Serial.println(text);
    Serial.setTxTimeoutMs(0);
  } else {
    Serial.println("ERR export");
  }
  free(text);
  free(pkg);
}

static bool importSave(const char *text, size_t len, uint32_t now) {
  uint8_t *pkg = (uint8_t *)malloc(tama::Pet::kExportMax);
  char theme[40];
  size_t n = pkg ? tama::decodeSaveText(text, len, pkg, tama::Pet::kExportMax, theme, sizeof(theme)) : 0;
  tama::ImportResult r = n ? (strcmp(theme, tama::kTheme.id) ? tama::ImportResult::WrongTheme
                                                             : pet->importSave(pkg, n, now))
                           : tama::ImportResult::BadFormat;
  free(pkg);
  if (r != tama::ImportResult::Ok) {
    Serial.printf("ERR import %s\n", r == tama::ImportResult::WrongTheme ? "wrong theme"
                                     : r == tama::ImportResult::Corrupt  ? "damaged" : "not a save");
    return false;
  }
  pet->syncClock(hw::rtcEpoch());   // time since the export passes like time powered off
  return true;
}

static void handleSerial() {
  if (!Serial.available()) return;
  String line = Serial.readStringUntil('\n');
  line.trim();
  uint32_t now = millis();
  if (line == "STATS") {
    Serial.printf("species=%s lv=%u food=%u joy=%u ene=%u hyg=%u mess=%u wgt=%u mistakes=%u bond=%u streak=%u collected=%u/%u variant=%d\n",
                  pet->isEgg() ? "egg" : pet->speciesDef()->id, pet->level(), pet->food(), pet->joy(),
                  pet->energy(), pet->hygiene(), pet->mess(), pet->weight(), pet->careMistakes(), pet->bond(),
                  pet->streak(), pet->collectedCount(), tama::kTheme.speciesCount, pet->variant());
  } else if (line.startsWith("LVL ")) {
    pet->debugSetLevel((uint16_t)line.substring(4).toInt());
  } else if (line.startsWith("SPEC ")) {
    String id = line.substring(5);
    for (uint16_t i = 0; i < tama::kTheme.speciesCount; i++)
      if (id == tama::kTheme.species[i].id) pet->debugSetSpecies(i);
  } else if (line == "HATCH") {
    pet->eggTap(now); pet->eggTap(now); pet->eggTap(now);
  } else if (line == "EGGS") {   // simulate 20 egg rolls in the colour being hunted now
    bool alt = pet->phase() == tama::Phase::Variant;
    for (int i = 0; i < 20; i++) {
      uint16_t r = pet->rollEggSpecies(alt);
      Serial.printf("%s%s ", alt ? "*" : "", r == tama::kNoSpecies ? "(none)" : tama::kTheme.species[r].id);
    }
    Serial.println();
  } else if (line == "SAVE") {   // export: one TAMA-SAVE line (tools/board_save.py export)
    exportSave();
  } else if (line.startsWith("LOAD ")) {   // import: LOAD <TAMA-SAVE text> (tools/board_save.py import)
    if (!importSave(line.c_str() + 5, line.length() - 5, now)) return;
  } else if (line.startsWith("TIME ")) {
    uint32_t e = (uint32_t)line.substring(5).toInt();
    hw::rtcSetEpoch(e);
    pet->setClock(e);
  } else if (line == "ABANDON") {
    pet->debugRunawayReady();
  } else if (line == "WIPE") {
    pet->factoryReset(now);
    ESP.restart();
  } else if (line == "HEALTH") {
    Serial.printf("up=%lus heap=%u minheap=%u psram=%u bat=%d%% usb=%d\n", (unsigned long)(now / 1000),
                  (unsigned)ESP.getFreeHeap(), (unsigned)ESP.getMinFreeHeap(), (unsigned)ESP.getFreePsram(),
                  hw::batteryPercent(), hw::usbPresent());
  } else if (line.length()) {
    Serial.println("commands: STATS LVL n SPEC id HATCH EGGS TIME epoch ABANDON WIPE HEALTH SAVE LOAD text");
    return;
  }
  Serial.println("DONE");
}

void setup() {
  Serial.setRxBufferSize(16384);   // a LOAD line (save import) is up to ~11 KB
  Serial.begin(115200);
  Serial.setTxTimeoutMs(0);   // never block the game when no USB host is reading
  Serial.printf("tamatouhou fw %s, theme %s v%u\n", TAMA_VERSION, tama::kTheme.id, tama::kTheme.version);

  Wire.begin(IIC_SDA, IIC_SCL);
  Wire.setTimeOut(50);        // safety net for PMU/RTC (the touch driver ignores it)

  hw::powerBegin();           // BLDO1 (panel VDD) must be on before the display starts
  hw::displayBegin();
  rotationBegin();            // Settings > Rotate screen (stored on the board, not the pet)
  app::gfx = hw::gfx;         // the shared screens (lib/app) draw into the board's canvas
  hw::touchBegin();
  assetsBegin();
  hw::rtcBegin();

  rng.seed(esp_random());
  kv = new NvsKv(themeNamespace());
  pet = new tama::Pet(tama::kTheme, *kv, rng);
  pet->begin(millis());

  // The RTC has no backup cell: if it lost the time, reseed it from the last time we saw so
  // game time never goes backwards (TamaPoke 1.13).
  uint32_t e = hw::rtcEpoch();
  if (!e) {
    uint32_t seed = 1767225600UL;   // 2026-01-01
    if (pet->lastSeenEpoch() > seed) seed = pet->lastSeenEpoch();
    hw::rtcSetEpoch(seed);
    e = hw::rtcEpoch();
  }
  pet->syncClock(e);          // apply the time spent powered off

  hw::audioBegin();
  ui::begin(*pet);
  lastInteract = millis();
}

void loop() {
  uint32_t now = millis();
  pet->update(now);
  ui::onEvents(pet->takeEvents());
  hw::audioSetSleeping(pet->sleeping());

  bool pressed;
  int16_t x, y;
  gestures.longPressMs = ui::longPressMs();   // 1 s on grids, 3 s on the pet (release)
  if (hw::touchRead(pressed, x, y)) {
    glassToScreen(plat::rotation(), x, y);   // the canvas may be turned (Settings)
    bool wake = !gestures.isDown() && pressed && (dimStage > 0 || screenOff);
    if (pressed) {
      lastInteract = now;
      screenOff = false;
    }
    ui::onGesture(gestures.feed(pressed, x, y, now, wake), now);   // the waking touch only wakes
  }
  handleSerial();

  static uint32_t lastPwr = 0;
  if (now - lastPwr > 250) {
    lastPwr = now;
    if (hw::pwrShortPressed()) {
      screenOff = !screenOff;
      if (!screenOff) lastInteract = now;
    }
  }
  updateBrightness(now);

  // NVS writes freeze both cores ~1 s: flush periodic saves only when nobody's watching
  if (pet->savePending() && (screenOff || dimStage >= 1 || pet->sleeping())) pet->flushSave();
  if (screenOff || now - lastInteract > 5000) rotationFlush();   // once the rotate taps stop

  static uint32_t lastClock = 0;
  if (now - lastClock > 30000) {   // keep real time for streaks and day/night
    lastClock = now;
    pet->noteEpoch(hw::rtcEpoch());
  }

  // Skip rendering with the screen off: the redraw + flush is ~70% of the CPU.
  if (!screenOff && now - lastRender >= ui::frameIntervalMs()) {
    lastRender = now;
    ui::render(now);
  }
}
